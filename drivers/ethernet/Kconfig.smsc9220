## drivers/ethernet/Kconfig.smsc9220
```kconfig
#
# Copyright (c) 2018 ...
#
# SPDX-License-Identifier: Apache-2.0
#

menuconfig ETH_SMSC9220
	bool "SMSC9220 Ethernet driver"
	depends on NET_L2_ETHERNET
	help
	  !!!Enable Synopsys DesignWare Ethernet driver.
```

## modules/Kconfig.iot-device-sdk-embedded-c
```kconfig
# Copyright 2018-2019 Google LLC
#
# SPDX-License-Identifier: Apache-2.0

config GOOGLE_IOT_DEVICE_SDK
	bool "Google IoT Device SDK support"
	help
	  This option enables the Google MQTT IoT connectivity.
```

## samples/net/sockets/big_http_download/Kconfig
```kconfig
# Private config options for big_http_download sample

# Copyright (c) 2020 Linaro Limited
# SPDX-License-Identifier: Apache-2.0

mainmenu "big_http_download sample application"

config SAMPLE_BIG_HTTP_DL_URL
	string "Download URL"
	default "http://archive.ubuntu.com/ubuntu/dists/xenial/main/installer-amd64/current/images/hd-media/vmlinuz"
	help
	  URL to download.

config SAMPLE_BIG_HTTP_DL_HASH
	string "Hash of downloaded file"
	default "\x33\x7c\x37\xd7\xec\x00\x34\x84\x14\x22\x4b\xaa\x6b\xdb\x2d\x43\xf2\xa3\x4e\xf5\x67\x6b\xaf\xcd\xca\xd9\x16\xf1\x48\xb5\xb3\x17"
	help
	  SHA-256 hash of the download file, as a binary string, in C escapes
	  format (e.g. "\x00\xff...").

source "Kconfig.zephyr"
```

## samples/posix/eventfd/sample.yaml
```yaml
sample:
  description: Extended POSIX (Linux) API eventfd() example
  name: eventfd
common:
  filter: TOOLCHAIN_HAS_NEWLIB == 1
  tags: posix
tests:
  sample.posix.eventfd:
    tags: posix
```

## tests/posix/common/testcase.yaml
```yaml
tests:
  portability.posix:
    tags: posix
    min_ram: 64
    # Currently, POSIX subsystem and "posix" pseudo-arch don't work well
    # together. This is supposed to be addressed later.
    # riscv toolchain lacks sys/timespec.h (maybe something else), so not
    # good for POSIX.
    arch_exclude: posix riscv32 xtensa
    # qemu_x86_64 currently uses Linux host toolchains, which leaks host
    # headers into the build.
    platform_exclude: qemu_x86_64
```

## tests/posix/fs/testcase.yaml
```yaml
tests:
  portability.posix:
    # Currently, POSIX subsystem and "posix" pseudo-arch don't work well
    # together. This is supposed to be addressed later.
    # riscv toolchain lacks sys/timespec.h (maybe something else), so not
    # good for POSIX.
    arch_exclude: nios2 posix riscv32
    # qemu_x86_64 currently uses Linux host toolchains, which leaks host
    # headers into the build.
    platform_exclude: qemu_x86_64
    min_ram: 128
    tags: posix filesystem
```
