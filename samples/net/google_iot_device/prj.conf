## CMakeLists.txt
```
# SPDX-License-Identifier: Apache-2.0

cmake_minimum_required(VERSION 3.13.1)

include($ENV{ZEPHYR_BASE}/cmake/app/boilerplate.cmake NO_POLICY_SCOPE)
project(google_iot_device)

set(IOTC_PATH ${CMAKE_CURRENT_SOURCE_DIR}/../../../../modules/lib/google/iot-device-sdk-embedded-c)

zephyr_include_directories(${APPLICATION_SOURCE_DIR}/src/tls_config)

zephyr_include_directories(app PRIVATE ${IOTC_PATH}/include)
zephyr_include_directories(app PRIVATE ${IOTC_PATH}/include/bsp)

zephyr_include_directories(app PRIVATE ${IOTC_PATH}/src/bsp)
zephyr_include_directories(app PRIVATE ${IOTC_PATH}/src/libiotc)
zephyr_include_directories(app PRIVATE ${IOTC_PATH}/src/libiotc/memory)
zephyr_include_directories(app PRIVATE ${IOTC_PATH}/src/libiotc/datastructures)

#  ERROR: TODO(atigyi): cert verify MUST be turned back on
add_compile_definitions(IOTC_DISABLE_CERTVERIFY)

target_sources(app PRIVATE
	src/main.c
	src/config.c
	src/example_utils.c
	src/bsp/iotc_bsp_tls_mbedtls.c
	src/bsp/iotc_bsp_crypto_mbedtls.c
	# TODO(atigyi): implement the BSP IO FS
	#  src/bsp/iotc_bsp_io_fs_zephyr.c
	src/bsp/iotc_bsp_io_net_zephyr.c
	src/bsp/iotc_bsp_mem_zephyr.c
	src/bsp/iotc_bsp_rng_zephyr.c
	src/bsp/iotc_bsp_time_zephyr.c
	)
```

## prj.conf
```kconfig
# Networking config
CONFIG_NETWORKING=y
CONFIG_NET_IPV4=y
CONFIG_NET_IPV6=n
CONFIG_NET_ARP=y
CONFIG_NET_UDP=y
CONFIG_NET_TCP=y
CONFIG_NET_SOCKETS=y
CONFIG_SNTP=y

# For BOARD=native_posix, CONFIG_NET_SOCKETS_POSIX_NAMES must be enabled
# For real Zephyr boards, CONFIG_POSIX_API & CONFIG_NEWLIB_LIBC must be enabled
#CONFIG_NET_SOCKETS_POSIX_NAMES=y
CONFIG_POSIX_API=y
CONFIG_NEWLIB_LIBC=y

# Network address config
CONFIG_NET_CONFIG_SETTINGS=y
CONFIG_NET_CONFIG_NEED_IPV6=n
CONFIG_NET_CONFIG_NEED_IPV4=y
CONFIG_NET_CONFIG_MY_IPV4_ADDR="192.0.2.1"
CONFIG_NET_CONFIG_MY_IPV4_GW="192.0.2.2"
CONFIG_NET_CONFIG_PEER_IPV4_ADDR="192.0.2.2"

#  CONFIG_ETH_NATIVE_POSIX_STARTUP_AUTOMATIC=y

# Enable the DNS resolver
CONFIG_DNS_RESOLVER=y
CONFIG_DNS_RESOLVER_ADDITIONAL_BUF_CTR=5
CONFIG_DNS_RESOLVER_ADDITIONAL_QUERIES=2
CONFIG_DNS_RESOLVER_MAX_SERVERS=1
CONFIG_DNS_SERVER_IP_ADDRESSES=y
CONFIG_DNS_NUM_CONCUR_QUERIES=5

# Google DNS IPv4 and IPv6 servers
CONFIG_DNS_SERVER1="8.8.8.8"

# Kernel options
CONFIG_HEAP_MEM_POOL_SIZE=16384
CONFIG_MAIN_STACK_SIZE=8192

# Enable Google IoT Device SDK
CONFIG_GOOGLE_IOT_DEVICE_SDK=y

# Enable MBEDTLS
CONFIG_MBEDTLS=y
CONFIG_MBEDTLS_BUILTIN=y
CONFIG_MBEDTLS_USER_CONFIG_ENABLE=y
CONFIG_MBEDTLS_USER_CONFIG_FILE="tls-null-entropy.conf"
CONFIG_MBEDTLS_ENTROPY_ENABLED=y

#  CONFIG_MBEDTLS_SSL_MAX_CONTENT_LEN=16384
CONFIG_MBEDTLS_SSL_MAX_CONTENT_LEN=8192
CONFIG_MBEDTLS_ENABLE_HEAP=y
CONFIG_MBEDTLS_HEAP_SIZE=56240

CONFIG_MBEDTLS_DEBUG=y
CONFIG_MBEDTLS_PEM_CERTIFICATE_FORMAT=y
CONFIG_MBEDTLS_KEY_EXCHANGE_ECDHE_ECDSA_ENABLED=y
CONFIG_MBEDTLS_ECP_DP_SECP192R1_ENABLED=y
CONFIG_MBEDTLS_ECP_DP_SECP256R1_ENABLED=y
CONFIG_MBEDTLS_HMAC_DRBG_ENABLED=y
CONFIG_MBEDTLS_ECDSA_DETERMINISTIC=y
```

## src/main.c
```c
/* Copyright 2019 Google LLC
 *
 * SPDX-License-Identifier: Apache-2.0
 */

#include <string.h>
#include <zephyr.h>

#include "config.h"
#include "example_utils.h"
#include <iotc.h>
#include <iotc_jwt.h>
#include <iotc_error.h>

iotc_crypto_key_data_t iotc_connect_private_key_data;
char ec_private_key_pem[PRIVATE_KEY_BUFFER_SIZE] = {0};

void main(void) {
  printk("Example for Zephyr port.\n");

  if (0 != load_ec_private_key_pem(ec_private_key_pem,
                                   PRIVATE_KEY_BUFFER_SIZE)) {
    printk("\nApplication exiting due to private key load error.\n\n");
    return;
  }

  /* Format the key type descriptors so the client understands
     what type of key is being represented. In this case, a PEM encoded
     byte array of a ES256 key. */
  iotc_connect_private_key_data.crypto_key_signature_algorithm =
      IOTC_CRYPTO_KEY_SIGNATURE_ALGORITHM_ES256;
  iotc_connect_private_key_data.crypto_key_union_type =
      IOTC_CRYPTO_KEY_UNION_TYPE_PEM;
  iotc_connect_private_key_data.crypto_key_union.key_pem.key =
      ec_private_key_pem;

  printk("Starting GCP IoT Embedded C Client...\n");

  iotc_initialize();

  iotc_context_handle_t iotc_context = iotc_create_context();

  const uint16_t connection_timeout = 10;
  const uint16_t keepalive_timeout = 10;

  /* Generate the client authentication JWT, which will serve as the MQTT
   * password. */
  char jwt[IOTC_JWT_SIZE] = {0};
  size_t bytes_written = 0;
  iotc_state_t state = iotc_create_iotcore_jwt(
      iotc_project_id,
      /*jwt_expiration_period_sec=*/3600, &iotc_connect_private_key_data, jwt,
      IOTC_JWT_SIZE, &bytes_written);

  if (IOTC_STATE_OK != state) {
    printk("iotc_create_iotcore_jwt returned with error: %ul : %s", state, iotc_get_state_string(state));
    return;
  }

  iotc_connect(iotc_context, /*username=*/NULL, /*password=*/jwt,
               /*client_id=*/iotc_device_path, connection_timeout,
               keepalive_timeout, &on_connection_state_changed);

  iotc_events_process_blocking();

  /*  Cleanup the default context, releasing its memory */
  iotc_delete_context(iotc_context);

  /* Cleanup internal allocations that were created by iotc_initialize. */
  iotc_shutdown();
}

int load_ec_private_key_pem(char* buf_ec_private_key_pem, size_t buf_len) {
  strncpy(buf_ec_private_key_pem, iotc_private_key_pem, buf_len);
  buf_ec_private_key_pem[buf_len - 1] = 0;
  return 0;
}
```

## src/commandline.c
```c
/* Copyright 2019 Google LLC
 *
 * SPDX-License-Identifier: Apache-2.0
 */

/*
 * This module implements a command line argument parser
 */

#include "commandline.h"
#include <assert.h>
#include <stdio.h>
#include <stdlib.h>
#include "iotc.h"

#ifndef IOTC_CROSS_TARGET
#include <getopt.h>
#define IOTC_EXAMPLE_DEFAULT_QOS IOTC_MQTT_QOS_AT_LEAST_ONCE
#else
#define IOTC_EXAMPLE_DEFAULT_QOS IOTC_MQTT_QOS_AT_MOST_ONCE
#endif /* IOTC_CROSS_TARGET */

void iotc_usage(const char* options, unsigned options_length);

iotc_mqtt_qos_t iotc_example_qos = IOTC_EXAMPLE_DEFAULT_QOS;

#define DEFAULT_PRIVATE_KEY_FIILENAME "ec_private.pem"

const char* iotc_project_id;
const char* iotc_device_path;
const char* iotc_publish_topic;
const char* iotc_publish_message;
const char* iotc_private_key_filename;

int iotc_parse(int argc, char** argv, char* valid_options,
               unsigned options_length) {
  int c;
  int iotc_help_flag = 0;
  iotc_project_id = NULL;
  iotc_device_path = NULL;
  iotc_publish_topic = NULL;
  iotc_private_key_filename = DEFAULT_PRIVATE_KEY_FIILENAME;
  iotc_publish_message = "Hello From Your IoTC client!";

  while (1) {
    static struct option long_options[] = {
        {"help", no_argument, 0, 'h'},
        {"project_id", required_argument, 0, 'p'},
        {"device_path", required_argument, 0, 'd'},
        {"publish_topic", required_argument, 0, 't'},
        {"publish_message", required_argument, 0, 'm'},
        {"private_key_filename", optional_argument, 0, 'f'},
        {0, 0, 0, 0}};

    /* getopt_long stores the option index here. */
    int option_index = 0;

    c = getopt_long(argc, argv, valid_options, long_options, &option_index);

    /* Detect the end of the options. */
    if (-1 == c) {
      break;
    }

    switch (c) {
      case 'p':
        iotc_project_id = optarg;
        break;
      case 'd':
        iotc_device_path = optarg;
        break;
      case 't':
        iotc_publish_topic = optarg;
        break;
      case 'm':
        iotc_publish_message = optarg;
        break;
      case 'f':
        iotc_private_key_filename = optarg;
        break;
      case 'h':
      default:
        iotc_help_flag = 1;
        break;
    }
  }

  /* Print any unrecognized command line arguments. */
  if (optind < argc) {
    printf(
        "The application could not recognize the following non-option "
        "arguments: ");
    while (optind < argc) {
      printf("%s ", argv[optind++]);
    }
    putchar('\n');
  }
  putchar('\n');

  if (1 == iotc_help_flag) /* Print the usage statement */
  {
    iotc_usage(valid_options, options_length);
    return (
        -1); /* Don't run the application if -h --help was on the commandline */
  }

  return (0);
}

void iotc_usage(const char* options, unsigned options_length) {
  assert(NULL != options);

  /* For debugging printf( "options = %s %d\n", options, options_length ); */

  printf("Usage:\n");
  while (0 < options_length) {
    /* printf( "parsing option %c\n", *options ); */
    switch (*options) {
      case 'p':
        printf(
            "-p --project_id\n\tProvide the project_id your device is "
            "registered in "
            "Cloud IoT Core.\n");
        break;
      case 'd':
        printf(
            "-d --device_path\n\tProvide the full path of your device. For "
            "example:\n"
            "\t\tprojects/<project_id>/locations/<cloud_region>/registries/"
            "<registry_id>/devices/<device_id>\n");
        break;
      case 't':
        printf("-t --publish_topic\n\tThe topic on which to subscribe.\n");
        break;
      case 'm':
        printf(
            "-m --publish_message\n\tThe message to publish. A shell quoted "
            "string of characters.\n");
        break;
      case 'f':
        printf(
            "-f --private_key_filename\n\tThe filename, including path from "
            "cwd,\n");
        printf(" \t of the device identifying private_key. Defaults to: %s\n",
               DEFAULT_PRIVATE_KEY_FIILENAME);
        break;
      case 'h': /* Don't print anything for the help option since we're printing
                   usage */
        break;
      case ':': /* We'll skip the ':' character since it's not an option. */
        break;
      case '\0':
        break;
      default:
        printf("WARNING: Option %c not recognized by usage()\n", *options);
    }
    ++options;
    --options_length;
  }
  printf("\n");
}
```

## src/commandline.h
```c
/*
 * This module implements a command line argument parser.
 */

#include <iotc_mqtt.h>

/* Flags set by commandline arguments. */
extern iotc_mqtt_qos_t iotc_example_qos;

/* Parameters returned by the parser. These will be in a structure someday. */
extern const char* iotc_project_id;
extern const char* iotc_device_path;
extern const char* iotc_publish_topic;
extern const char* iotc_publish_message;
extern const char* iotc_private_key_filename;

int iotc_parse(int argc, char** argv, char* valid_options,
               const unsigned options_length);
```

## src/config.h
```c
/* Copyright 2019 Google LLC
 *
 * SPDX-License-Identifier: Apache-2.0
 */

/*
 * Declarations for application config options.
 */

#include <iotc_mqtt.h>

extern iotc_mqtt_qos_t iotc_example_qos;

extern const char* iotc_project_id;
extern const char* iotc_device_path;
extern const char* iotc_private_key_pem;
extern const char* iotc_publish_topic;
extern const char* iotc_publish_message;
```

## src/example_utils.c
```c
/* Copyright 2019 Google LLC
 *
 * SPDX-License-Identifier: Apache-2.0
 */

#include <iotc_error.h>
#include <iotc_jwt.h>
#include <stdio.h>

#include "config.h"
#include "example_utils.h"

#define IOTC_UNUSED(x) (void)(x)

extern iotc_crypto_key_data_t iotc_connect_private_key_data;

static iotc_timed_task_handle_t delayed_publish_task =
    IOTC_INVALID_TIMED_TASK_HANDLE;

void on_connection_state_changed(iotc_context_handle_t in_context_handle,
                                 void* data, iotc_state_t state) {
  iotc_connection_data_t* conn_data = (iotc_connection_data_t*)data;

  if (NULL == conn_data) {
    return;
  }

  switch (conn_data->connection_state) {
    /* IOTC_CONNECTION_STATE_OPENED means that the connection has been
       established and the IoTC Client is ready to send/recv messages */
    case IOTC_CONNECTION_STATE_OPENED:
      printf("connected to %s:%d\n", conn_data->host, conn_data->port);

      /* Publish immediately upon connect. 'publish_function' is defined
         in this example file and invokes the IoTC API to publish a
         message. */
      publish_function(in_context_handle, IOTC_INVALID_TIMED_TASK_HANDLE,
                       /*user_data=*/NULL);

      /* Create a timed task to publish every 5 seconds. */
      delayed_publish_task =
          iotc_schedule_timed_task(in_context_handle, publish_function, 5, 15,
                                   /*user_data=*/NULL);
      break;

    /* IOTC_CONNECTION_STATE_OPEN_FAILED is set when there was a problem
       when establishing a connection to the server. The reason for the error
       is contained in the 'state' variable. Here we log the error state and
       exit out of the application. */
    case IOTC_CONNECTION_STATE_OPEN_FAILED:
      printf("ERROR!\tConnection has failed reason %d : %s\n\n", state,
             iotc_get_state_string(state));

      /* exit it out of the application by stopping the event loop. */
      iotc_events_stop();
      break;

    /* IOTC_CONNECTION_STATE_CLOSED is set when the IoTC Client has been
        disconnected. The disconnection may have been caused by some external
        issue, or user may have requested a disconnection. In order to
       distinguish between those two situation it is advised to check the state
       variable value. If the state == IOTC_STATE_OK then the application has
       requested a disconnection via 'iotc_shutdown_connection'. If the state !=
       IOTC_STATE_OK then the connection has been closed from one side.
      */
    case IOTC_CONNECTION_STATE_CLOSED: {
      /* When the connection is closed it's better to cancel some of previously
         registered activities. Using cancel function on handler will remove the
         handler from the timed queue which prevents the registered handle to be
         called when there is no connection. */
      if (IOTC_INVALID_TIMED_TASK_HANDLE != delayed_publish_task) {
        iotc_cancel_timed_task(delayed_publish_task);
        delayed_publish_task = IOTC_INVALID_TIMED_TASK_HANDLE;
      }

      if (state == IOTC_STATE_OK) {
        /* The connection has been closed intentionally. Therefore, stop
         * the event processing loop as there's nothing left to do
         * in this example. */
        iotc_events_stop();
      } else {
        printf("connection closed - reason %d : %s!\n", state,
               iotc_get_state_string(state));
        /* The disconnection was unforeseen.  Try to reconnect to the server
           with the previously set username and client_id, but regenerate
           the client authentication JWT password in case the disconnection
           was due to an expired JWT. */
        char jwt[IOTC_JWT_SIZE] = {0};
        size_t bytes_written = 0;
        state = iotc_create_iotcore_jwt(iotc_project_id,
                                        /*jwt_expiration_period_sec=*/3600,
                                        &iotc_connect_private_key_data, jwt,
                                        IOTC_JWT_SIZE, &bytes_written);
        if (IOTC_STATE_OK != state) {
          printf(
              "iotc_create_iotcore_jwt returned with error"
              " when attempting to reconnect: %ul\n",
              state);
        } else {
          iotc_connect(in_context_handle, conn_data->username, jwt,
                       conn_data->client_id, conn_data->connection_timeout,
                       conn_data->keepalive_timeout,
                       &on_connection_state_changed);
        }
      }
    } break;
    default:
      printf("wrong value\n");
      break;
  }
}

void publish_function(iotc_context_handle_t context_handle,
                      iotc_timed_task_handle_t timed_task, void* user_data) {
  /* timed_task is a handle to the reoccurring task that may have invoked
     this function.  We could use it to cancel the task here, but we want
     it to keep repeating.*/
  IOTC_UNUSED(timed_task);

  /* user data is a anonymous payload that the application can use to
     feed non-typed information to scheduled function calls / events.
     Here the application feeds a value of NULL (as defined in the
     function 'on_connection_state_changed' above, so we can ignore it.) */
  IOTC_UNUSED(user_data);

  printf("publishing msg \"%s\" to topic: \"%s\"\n", iotc_publish_message,
         iotc_publish_topic);

  iotc_publish(context_handle, iotc_publish_topic, iotc_publish_message,
               iotc_example_qos,
               /*callback=*/NULL, /*user_data=*/NULL);
}
```

## src/example_utils.h
```c
/* Copyright 2019 Google LLC
 *
 * SPDX-License-Identifier: Apache-2.0
 */

#define PRIVATE_KEY_BUFFER_SIZE 256

#include <iotc.h>

/* Attempts to load the client's identifying private key so that the
   byte data may be passed to the 'iotc_connect function'.  Please note that the
   IoTC API and Board Support Package have various means to use private keys.
   This example assumes the use of one that must be provided to a TLS
   implementation in a buffer, but secure chips with slot-based key stores can
   also be used. Please see the Crypto BSP for more information. */
int load_ec_private_key_pem(char* buf_ec_private_key_pem, size_t buf_len);

/* A callback function that will be invoked whenever the connection state
   has changed.

   Information about the status of the connection will be provided by the
   IoTC library via the function parameters of this callback.

   DATA:
    a iotc_connection_data_t structure which holds a connection_state parameter
    that can be monitored to determine the health of the connection:

    IOTC_CONNECTION_STATE_OPENED - the connection has been successfully
   established, and TLS handshaking has verified the server certificate.  The
   client is read to publish and subscribe to topics.
    IOTC_CONNECTION_STATE_OPEN_FAILED - there was an error in the connection
        process and the connection could not be made. You can determine the
        reason in the iotc_state_t, which contains a standard IoTC error code.
    IOTC_CONNECTION_STATE_CLOSED - disconnected from Google Cloud IoT Core
   service, with the reason provided in iotc_state_t. Note: there are two
   possible reasons of being disconnected: a) the application initiated the
   disconnection procedure through a call to iotc_shutdown_connection b) there
   has been a problem with maintaining the connection, or the service shutdown
   the connection expectantly.

        Determining which of these scenarios has occured can be done by
        checking the iotc_state_t parameter of the callback.

        if state == IOTC_STATE_OK , the application intentionally disconnected
        if state != IOTC_STATE_OK , the disconnection was unexpected, and the
   state contains an error code as to what happened.

        In the case of this example,
        the application's response to a successful connection is to create a
            repeating timed task to publish a message on the configured topic.
            If an intentional disconnection occurs, then the client application
            exists.  If an unforeseen disconnection occurs, or if the connection
            fails, then the application reattempts the connection.  */
void on_connection_state_changed(iotc_context_handle_t in_context_handle,
                                 void* data, iotc_state_t state);

/* A function that publishes to the topic that was specified in the config
   parameters of the application. This is invoked directly upon connect
   in the 'on_connection_state_changed' function, but also by the IoTC Client's
   event system on a 5 second interval. */
void publish_function(iotc_context_handle_t context_handle,
                      iotc_timed_task_handle_t timed_task, void* user_data);
```
