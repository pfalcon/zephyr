## prj.conf
```kconfig
# General config
CONFIG_NEWLIB_LIBC=y
CONFIG_MAIN_STACK_SIZE=6000
CONFIG_MBEDTLS=y
CONFIG_MBEDTLS_CFG_FILE="config-mini-tls1_2.h"
CONFIG_MBEDTLS_SSL_MAX_CONTENT_LEN=16384
CONFIG_MBEDTLS_ENABLE_HEAP=y
CONFIG_MBEDTLS_HEAP_SIZE=50000

# Networking config
CONFIG_NETWORKING=y
CONFIG_NET_IPV4=y
CONFIG_NET_IPV6=y
CONFIG_NET_TCP=y
CONFIG_NET_SOCKETS=y
CONFIG_NET_SOCKETS_POSIX_NAMES=y

CONFIG_DNS_RESOLVER=y
CONFIG_DNS_SERVER_IP_ADDRESSES=y
CONFIG_DNS_SERVER1="192.0.2.2"

# Network driver config
CONFIG_TEST_RANDOM_GENERATOR=y

# Network address config
CONFIG_NET_APP_SETTINGS=y
CONFIG_NET_APP_NEED_IPV4=y
CONFIG_NET_APP_MY_IPV4_ADDR="192.0.2.1"
CONFIG_NET_APP_PEER_IPV4_ADDR="192.0.2.2"
CONFIG_NET_APP_MY_IPV4_GW="192.0.2.2"

# Network debug config
CONFIG_NET_LOG=y
CONFIG_NET_LOG_GLOBAL=y
CONFIG_SYS_LOG_NET_LEVEL=2
#CONFIG_NET_DEBUG_SOCKETS=y
```

## src/example.c
```c
#include <net/socket.h>
#include <kernel.h>
#include <net/net_app.h>

static char msg[] = "Lorem ipsum dolor sit amet";
static char response[sizeof(msg)] = {};

int main(void)
{
	static struct addrinfo hints;
	struct addrinfo *a;
	int r, s;

	hints.ai_family = AF_INET;
	hints.ai_socktype = SOCK_STREAM;

	r = getaddrinfo(CONFIG_NET_APP_PEER_IPV4_ADDR, "4242", &hints, &a);
	if (r != 0) {
		return r;
	}

	s = socket(a->ai_family, a->ai_socktype, a->ai_protocol);
	if (s < 0) {
		return s;
	}

	r = send(s, msg, sizeof(msg), 0);
	if (r != sizeof(msg)) {
		return r;
	}

	r = recv(s, response, sizeof(response), 0);
	if (r != sizeof(msg)) {
		return r;
	}

	close(s);

	return 0;
}
```
